## CMakeLists.txt
```
# SPDX-License-Identifier: Apache-2.0

cmake_minimum_required(VERSION 3.20.0)
find_package(Zephyr REQUIRED HINTS $ENV{ZEPHYR_BASE})
project("HH Memory Test")

target_sources(app PRIVATE 
    src/main.c
    src/memory_manager.c
    src/common.h
)

target_include_directories(app PRIVATE src)
```

## prj.conf
```kconfig
CONFIG_GPIO=y

#### Logging ####
CONFIG_CONSOLE=y
CONFIG_LOG=y
CONFIG_LOG_MODE_IMMEDIATE=y
CONFIG_NVS_LOG_LEVEL_DBG=y

#### NVS/Flash ####
CONFIG_FLASH=y
CONFIG_FLASH_PAGE_LAYOUT=y
CONFIG_NVS=y
CONFIG_MPU_ALLOW_FLASH_WRITE=y
```

## src/main.c
```c
/*
 * Copyright (c) 2016 Intel Corporation
 *
 * SPDX-License-Identifier: Apache-2.0
 */

#include <zephyr/kernel.h>
#include <zephyr/drivers/gpio.h>


#include "memory_manager.h"

#define MODULE_NAME main

LOG_MODULE_REGISTER(MODULE_NAME, LOG_LEVEL_DBG);


int main(void)
{
	int ret;
	size_t count = 0;
	uint32_t buffer = 0;
	const char* test_label[] = {"test_val_1", "test_val_2", "test_val_3"};

	LOG_DBG("Start NVS Test");
	LOG_DBG("KEYS: [%s], [%s], [%s]", test_label[0], test_label[1], test_label[2]);

	ret = memory_manager_init();
	if (ret) {
		LOG_DBG("Error Code: [%d]", ret);
	}

	while(1) {

		k_msleep(1000);
		LOG_DBG("---------------------------------");
		for(size_t i = 0; i < g_num_items; i++) {
			
			ret = memory_load(test_label[i], (uint8_t *)&buffer, sizeof(buffer));
			if (ret) {
				LOG_DBG("Error Code: [%d]", ret);
			}
			buffer = i + count;
			ret = memory_save(test_label[i], (uint8_t *)&buffer, sizeof(buffer));
			if (ret) {
				LOG_DBG("Error Code: [%d]", ret);
			}
			LOG_WRN("%s.value = %u", test_label[i], buffer);
			count++;
		}	
	}
	return 0;
}
```

## src/common.h
```c
#ifndef __COMMON_H__
#define __COMMON_H__

#include <stdint.h>
#include <stddef.h>
#include <stdbool.h>
#include <string.h>

#include <zephyr/device.h>
#include <zephyr/devicetree.h>
#include <zephyr/logging/log.h>

#endif
```

## src/dictionary.h
```c
#ifndef __DICTIONARY_H__
#define __DICTIONARY_H__

#include "common.h"

typedef enum data_type_e {
    TYPE_UINT8,
    TYPE_UINT16,
    TYPE_UINT32,
    TYPE_UINT64,
    TYPE_INT_8,
    TYPE_INT_16,
    TYPE_INT_32,
    TYPE_INT_64,   
    TYPE_CHAR,
    TYPE_STRING
} data_type_t;


typedef struct node_s {
    char *key;
    void *value;
    data_type_t type;
    node_t *next;
    node_t *prev;
} node_t;


typedef struct dict_s {
    size_t size, used;
    node_t **table;
} dict_t;


dict_t *dict_create(void);
void dict_delete(dict_t *dict);
void dict_insert(dict_t *dict, const char *key, void *value, data_type_t type);
node_t *dict_search(dict_t *dict, const char *key);
void dict_remove_entry(dict_t *dict, const char *key);
void dict_update_entry(dict_t *dict, const char* key, void *value, data_type_t type);

#endif
```

## src/memory_manager.c
```c
/*--------------------------------------------------------------  
-----  INCLUDES  -----------------------------------------------
----------------------------------------------------------------*/

/***************************************************************
 * 
 *  Include zephyr utilities 
 *  
 ***************************************************************/
#include <zephyr/drivers/flash.h>
#include <zephyr/storage/flash_map.h>
#include <zephyr/fs/nvs.h>
#include <zephyr/device.h>
#include <zephyr/devicetree.h>
#include <zephyr/logging/log.h>

/***************************************************************
 * 
 *  Include src utilities
 *  
 ***************************************************************/
#include "memory_manager.h"



/*--------------------------------------------------------------  
-----  DEFINES  ------------------------------------------------
----------------------------------------------------------------*/

/***************************************************************
 * 
 *  Define module name for debugging    
 *  
 ***************************************************************/
#define MODULE_NAME memory_manager

/***************************************************************
 * 
 *  Define nvs storage partitions
 *  
 ***************************************************************/
#define NVS_PARTITION		    storage_partition
#define NVS_PARTITION_DEVICE	FIXED_PARTITION_DEVICE(NVS_PARTITION)
#define NVS_PARTITION_OFFSET	FIXED_PARTITION_OFFSET(NVS_PARTITION)



/*--------------------------------------------------------------  
-----  ENUMS  --------------------------------------------------
----------------------------------------------------------------*/



/*--------------------------------------------------------------  
-----  STRUCTS  ------------------------------------------------
----------------------------------------------------------------*/

/***************************************************************
 * 
 *  Memory data members for load/save transactions
 *  
 ***************************************************************/
typedef struct memory_container_s {
    char* key;
    uint32_t id;
    uint32_t value;
} memory_container_t;



/*--------------------------------------------------------------  
-----  LOCAL MEMBER ("m_") VARIABLE DECLARATION  ---------------
----------------------------------------------------------------*/

/***************************************************************
 * 
 *  Memory data members for load/save transactions
 *  
 ***************************************************************/
LOG_MODULE_REGISTER(MODULE_NAME, LOG_LEVEL_DBG);

//static const struct device *m_memory_flash_device;                        // flash device 
static struct nvs_fs m_fs;                                                  // nvs file system
static bool m_is_initialized = false;                                       // initialization check
static memory_container_t m_items[] = {                                     // local data storage
    {"test_val_1", 1, 123}, {"test_val_2", 2, 123},
    {"test_val_3", 3, 123}}; 
                 




/*--------------------------------------------------------------  
-----  GLOBAL VARIABLE DECLARATION  ----------------------------
----------------------------------------------------------------*/
size_t g_num_items = sizeof(m_items) / sizeof(memory_container_t);   // number of data members   



/*--------------------------------------------------------------  
-----  GLOBAL VARIABLE REFS  -----------------------------------
----------------------------------------------------------------*/



/*--------------------------------------------------------------  
-----  GLOBAL VARIABLE REFS  -----------------------------------
----------------------------------------------------------------*/



/*--------------------------------------------------------------  
-----  LOCAL FUNCTION PROTOTYPES  ------------------------------
----------------------------------------------------------------*/
size_t _find_item_index(const char* key);


/*==============================================================
=====  Public APIs  ============================================
================================================================*/

/***************************************************************
 * 
 * @brief Initialization of Memory Manager
 *
 * Mount flash driver and initialize nvs. Set default parameter 
 * values if they do not yet exist in memory space.
 *
 * @param None
 *
 * @retval 0 returned if successful.
 * @retval Flash related errors of device binding or flash get page info fails.
 * @retval NVS error if nvs_init fails.
 * 
 ***************************************************************/
int memory_manager_init(void) 
{
    int err;
    struct flash_pages_info flash_info;

    // check if memory_manager is initialized alread
    if (m_is_initialized) {
        return 0;
    }

    // set up flash device
    m_fs.flash_device = NVS_PARTITION_DEVICE;
    if (!device_is_ready(m_fs.flash_device)) {
        LOG_WRN("Flash Device %s Not Ready", m_fs.flash_device->name);
        return MEMORY_ERR_FLASH_NOT_READY;
    }
    
    // get flash offset
    m_fs.offset = NVS_PARTITION_OFFSET;
    err = flash_get_page_info_by_offs(m_fs.flash_device, m_fs.offset, &flash_info);
    if (err) {
        LOG_WRN("Can't Get Flash Page Info");
        return MEMORY_ERR_FLASH_PAGE;
    }
    m_fs.sector_size = flash_info.size;
    m_fs.sector_count = 2U;

    // mount nvs device
    err = nvs_mount(&m_fs);
    if (err) {
        LOG_WRN("NVS Flash Mount Failed");
        return MEMORY_ERR_FLASH_MOUNT;
    }

    // get values stored in memory, or set default values if none exist
    for (size_t i=0; i < g_num_items; i++) {
        LOG_DBG("m_items[%u] : {key = %s, id = %u, value = %u}", i, m_items[i].key, m_items[i].id, m_items[i].value);
        err = nvs_read(&m_fs, m_items[i].id, &m_items[i].value, sizeof(m_items[i].value));
        if (err <= 0) {
            nvs_write(&m_fs, m_items[i].id, &m_items[i].value, sizeof(m_items[i].value));
        }
    }

    // memory_manager initialization complete
    m_is_initialized = true;
    return MEMORY_SUCCESS;
}


/***************************************************************
 * 
 * @brief Load value from nvs
 *
 * Use key to load value from memory and store it to data container
 * indicated by pointer.
 * 
 * @param[in]  key      Key of requested data
 * @param[out] data_p   Pointer to memory that data will be loaded into 
 * @param[in]  data_len Size of memory that data will be loaded into
 *
 * @retval 0 is returned if the param_id parameter was copied to the memory
 * space provided.
 * @retval The error returned by TestDataMemory(), if an error is detected.
 * 
 ***************************************************************/
int memory_load(const char* key, uint8_t *data_p, size_t data_len) 
{
    size_t index;

    // make sure nvs initialized
    if (!m_is_initialized) {
        LOG_WRN("NVS Not Initialized, Unable to Load");
        return MEMORY_ERR_NOT_INITIALIZED;
    }

    // get data index from key
    index = _find_item_index(key);
    if (index < 0) {
        LOG_WRN("Data Member [%s] Does Not Exist", key);
        return MEMORY_ERR_INVALID_KEY;
    }

    // load data from local struct to desired location
    memcpy(data_p, (uint8_t *)&m_items[index].value, data_len);
    return MEMORY_SUCCESS;
}


/***************************************************************
 * 
 * @brief Save value to nvs

 * Use key to save value to specified nvs location
 * 
 * @param[in]  key      Key of requested data
 * @param[out] data_p   Pointer to data that will be saved
 * @param[in]  data_len Size of memory that data will be saved
 *
 * @retval If the data pointer and size is correct, a positive integer offset
 * to the param_id in the m_param_data structure is returned.
 * @retval -EFAULT if the data pointer is NULL.
 * @retval -EINVAL if data_size in not correct for the given param_id
 * 
 ***************************************************************/
int memory_save(const char* key, uint8_t *data_p, size_t data_len) 
{
    int err;
    size_t index;
    
    // make sure nvs initialized
    if (!m_is_initialized) {
        LOG_WRN("NVS Not Initialized, Unable to Save");
        return MEMORY_ERR_NOT_INITIALIZED;
    }
    
    // get data index from key
    index = _find_item_index(key);
    if (index < 0) {
        LOG_WRN("Data Member [%s] Does Not Exist", key);
        return MEMORY_ERR_INVALID_KEY;
    }

    // save data from desired location to local struct
    memcpy((uint8_t *)&m_items[index].value, data_p, data_len);

    // write data to nvs and compare against number of bytes written (returned by func)
    // if not equal to 0 or length of data, an error has occured
    err = nvs_write(&m_fs, m_items[index].id, &m_items[index].value, data_len);
    if (err == 0 || err == data_len) {
        return MEMORY_SUCCESS;
    }
    else {
        return MEMORY_ERR_WRITE;
    }
}


/***************************************************************
 * 
 * @brief Access nvs functionality
 * Save or load by indicating access method. 
 * MEMORY_SAVE = true, MEMORY_LOAD = false
 * 
 * @param[in]  method   Access method
 * @param[in]  key      Key of requested data
 * @param[out] data_p   Pointer to data that will be saved
 * @param[in]  data_len Size of memory that data will be saved
 *
 * @retval If the data pointer and size is correct, a positive integer offset
 * to the param_id in the m_param_data structure is returned.
 * @retval -EFAULT if the data pointer is NULL.
 * @retval -EINVAL if data_size in not correct for the given param_id
 * 
 ***************************************************************/
int memory_access(int method, const char* key, uint8_t *data_p, size_t data_len) 
{   
    int ret;

    switch (method)
    {
    case MEMORY_LOAD:
        ret = memory_load(key, data_p, data_len);
        break;

    case MEMORY_SAVE:
        ret = memory_save(key, data_p, data_len);
        break;
    
    default:
        ret = MEMORY_ERR_ACCESS_DIR;
        break;
    }

    return ret;
}



/*==============================================================
=====  Private APIs  ===========================================
================================================================*/
/***************************************************************
 * 
 * @brief Find index of item in local data container
 *
 * Use key to save value to specified nvs location
 * 
 * @param[in]  key      Key of requested item
 *
 * @retval Index of data container if it exists
 * @retval 0 if key does not exist
 * 
 ***************************************************************/
size_t _find_item_index(const char* key) {
    for (size_t i=0; i < g_num_items; i++) {
        if (strcmp(m_items[i].key, key) == 0) {
            return i;
        }
    }
    return -1;
}
```

## src/memory_manager.h
```c
#ifndef __MEMORY_MANAGER_H__
#define __MEMORY_MANAGER_H__


/*----  Includes  ------------------------------------------------------------*/

#include "common.h"


/*----  Defines  -------------------------------------------------------------*/
#define MEMORY_SAVE     true
#define MEMORY_LOAD     false

/*----  Enumerations  --------------------------------------------------------*/
typedef enum memory_id_e {
    MEMORY_ID_TEST_1,
    MEMORY_ID_TEST_2,
    MEMORY_ID_TEST_3
} memory_id_t;

typedef enum memory_err_e {
    MEMORY_SUCCESS,
    MEMORY_ERR_ALREADY_INITIALIZED,
    MEMORY_ERR_FLASH_NOT_READY,
    MEMORY_ERR_FLASH_PAGE,
    MEMORY_ERR_FLASH_MOUNT,
    MEMORY_ERR_NOT_INITIALIZED,
    MEMORY_ERR_INVALID_KEY,
    MEMORY_ERR_WRITE,
    MEMORY_ERR_ACCESS_DIR
}memory_err_t;


/*----  Global Variables  ----------------------------------------------------*/
extern size_t g_num_items;

/*----  Structures  ----------------------------------------------------------*/

/*----  Callback Functions  --------------------------------------------------*/

/*----  Function prototypes --------------------------------------------------*/
int memory_manager_init(void);
int memory_load(const char* key, uint8_t *data_p, size_t data_len);
int memory_save(const char* key, uint8_t *data_p, size_t data_len);
int memory_access(int method, const char* key, uint8_t *data_p, size_t data_len);


#endif
```
